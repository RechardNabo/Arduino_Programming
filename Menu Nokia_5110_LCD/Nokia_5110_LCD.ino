#include <SPI.h>
#include <Adafruit_GFX.h>
#include <Adafruit_PCD8544.h>

#define BACKLIGHT 52
#define MENU_UP 26
#define ENTER 24
#define MENU_DOWN 22

// Declare LCD object for software SPI
// Adafruit_PCD8544(CLK,DIN,D/C,CE,RST);
Adafruit_PCD8544 display = Adafruit_PCD8544(0x02, 0x03, 0x04, 0x05, 0x06);


int menuitem = 1;
int page = 1;
int lastMenuItem = 1;


String menuItem1 = ">Picture";
String menuItem2 = ">Light :";
String menuItem3 = ">Reset";


boolean backlight = true;
boolean picture_displayed = false;
int contrast = 50;

volatile boolean up = false;
volatile boolean down = false;
volatile boolean middle = false;



int downButtonState = 0;
int upButtonState = 0;
int selectButtonState = 0;
int lastDownButtonState = 0;
int lastSelectButtonState = 0;
int lastUpButtonState = 0;



const unsigned char Rechard [] PROGMEM = {
  0x03, 0xf9, 0x00, 0x00, 0x00, 0x00, 0x00, 0x00, 0x00, 0x07, 0xf0, 0x03, 0xfb, 0x82, 0x0c, 0x00,
  0x00, 0x00, 0x00, 0x00, 0x00, 0x00, 0xff, 0xfb, 0x87, 0xc8, 0x00, 0x00, 0x00, 0x1f, 0x80, 0x00,
  0x00, 0xff, 0xff, 0x87, 0x80, 0x00, 0x00, 0x01, 0xff, 0xe0, 0x00, 0x00, 0xff, 0xff, 0x06, 0x7f,
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  0xf0, 0x00, 0x18, 0x38, 0x00, 0x00, 0x07, 0xc0, 0x3f, 0xfe, 0xff, 0xf0, 0x00, 0x10, 0x78, 0x00
};

void setup()   {
  Serial.begin(9600);

  pinMode(BACKLIGHT , OUTPUT);
  pinMode(MENU_UP, INPUT_PULLUP);
  pinMode(MENU_DOWN, INPUT_PULLUP);
  pinMode(ENTER, INPUT_PULLUP);
  digitalWrite(BACKLIGHT , LOW);
  display.begin();
  display.setContrast(contrast);
  display.clearDisplay();
  display.display();

}
//================================[Display picture function]===========================
void Display_Picture() {
  display.clearDisplay();
  display.drawBitmap(0, 0,  Rechard, 84, 48, BLACK);
  display.display();
}

//==============================[Moving display options ]==============================
void Menu_Display() {

  if (page == 1) {

    display.setTextSize(1);
    display.clearDisplay();
    display.setTextColor(BLACK, WHITE);
    display.setCursor(15, 0);
    display.print("MAIN MENU");
    display.drawFastHLine(0, 10, 83, BLACK);
    display.setCursor(0, 15);

    if (menuitem == 1) {

      display.setTextColor(WHITE, BLACK);
    }
    else {

      display.setTextColor(BLACK, WHITE);
    }
    display.print(menuItem1);
    display.setCursor(0, 25);

    if (menuitem == 2) {

      display.setTextColor(WHITE, BLACK);
    }
    else {

      display.setTextColor(BLACK, WHITE);
    }
    display.print(menuItem2);

    if (backlight) {

      display.print("ON");
    }
    else {

      display.print("OFF");
    }
    display.display();

    if (menuitem == 3) {

      display.setTextColor(WHITE, BLACK);
    }
    else {

      display.setTextColor(BLACK, BLACK);
    }
    display.setCursor(0, 35);
    display.print(menuItem3);
    display.display();
  }


  else if (page == 2) {

    display.setTextSize(1);
    display.clearDisplay();
    display.setTextColor(BLACK, WHITE);
    display.setCursor(15, 0);
    display.print("Picture");
    display.drawFastHLine(0, 10, 83, BLACK);
    display.setCursor(5, 15);
    Display_Picture();

  }
}
//====================================================================================================
void setContrast()
{
  display.setContrast(contrast);
  display.display();
}
//==============================================================================================
void resetDefaults() {
  contrast = 50;
  setContrast();
  backlight = true;
  turnBacklightOff();
}

//==============================================================================================
void turnBacklightOn() {
  digitalWrite(BACKLIGHT, HIGH);
}
void turnBacklightOff() {

  digitalWrite(BACKLIGHT, LOW);
}
//==============================[Moving buttons and menu functionaliity]==============================
void Menu_Function() {
  Menu_Display();
  downButtonState = digitalRead(MENU_DOWN);
  selectButtonState = digitalRead(ENTER);
  upButtonState =   digitalRead(MENU_UP);

  checkIfDownButtonIsPressed();
  checkIfUpButtonIsPressed();
  checkIfSelectButtonIsPressed();

  //==============================================

  if (up && page == 1 ) {
    up = false;
    menuitem--;
    if (menuitem==0)
    {
      menuitem=3;
    }      
 
  if (down && page == 1) {
    down = false;
    menuitem++;
    if (menuitem==4) 
    {
      menuitem=1;
    }      
  }
  //===================[Backlight function]===========================
  if (middle) {
    middle = false;

    if (page == 1 && menuitem == 2)
    {
      if (backlight)
      {
        backlight = false;
        turnBacklightOff();
      }
      else
      {
        backlight = true;
        turnBacklightOn();
      }
    } if ( page == 1 && menuitem == 1) {
      if (picture_displayed) {
        picture_displayed = false;
        page = 0x01;
        menuitem = 0x01;
      }
      else {
        picture_displayed = false;
        Display_Picture();
      }
    }
    if (page == 0x01 && menuitem == 0x03) {
      resetDefaults();
    }

    else if (page == 1 && menuitem == 1) {
      page = 0x02;
    }
    else if (page == 0x02) {
      page = 0x01;
    }
  }
}

//==================================[Button response functionallity]====================================
void checkIfDownButtonIsPressed() {

  if (downButtonState != lastDownButtonState)
  {
    if (downButtonState == 0)
    {
      down = true;
    }
    delay(50);
  }
  lastDownButtonState = downButtonState;
}

void checkIfUpButtonIsPressed() {

  if (upButtonState != lastUpButtonState)
  {
    if (upButtonState == 0) {
      up = true;
    }
    delay(50);
  }
  lastUpButtonState = upButtonState;
}
void checkIfSelectButtonIsPressed() {

  if (selectButtonState != lastSelectButtonState)
  {
    if (selectButtonState == 0) {
      middle = true;
    }
    delay(50);
  }
  lastSelectButtonState = selectButtonState;
}


void loop() {
  Menu_Function();
}
